## dell_7010_defconfig
```kconfig
# Target
CONFIG_VENDOR_DELL=y
CONFIG_BOARD_DELL_OPTIPLEX_7010=y

# Chipset
CONFIG_HAVE_IFD_BIN=y
CONFIG_HAVE_ME_BIN=y
CONFIG_HAVE_GBE_BIN=y

# Video (Choose based on your needs)
CONFIG_MAINBOARD_USE_LIBGFXINIT=y
CONFIG_GFX_GMA_PANEL_RES_1024X768=y # Change based on monitor if needed

# Payload
# CONFIG_PAYLOAD_SEABIOS=y 
CONFIG_PAYLOAD_TIANOCORE=y
```
